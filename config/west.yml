## config/west.yml
```yaml
manifest:
  remotes:
    - name: zmkfirmware
      url-base: https://github.com/zmkfirmware
    # nice_view_gem
    - name: m165437
      url-base: https://github.com/M165437
    # dongle_display
    - name: englmaxi
      url-base: https://github.com/englmaxi
    # nice_oled - dongle_display!view - oled Adapter
    - name: mctechnology17
      url-base: https://github.com/mctechnology17
    # W3ND31
    - name: wendel
      url-base: https://github.com/W3ND31
  projects:
    - name: zmk
      remote: zmkfirmware
      revision: main
      import: app/west.yml
    # nice_oled
    - name: zmk-nice-oled
      remote: wendel
      revision: main
    # oled Adapter
    - name: zmk-oled-adapter
      remote: mctechnology17
      revision: main
  self:
    path: config
```
